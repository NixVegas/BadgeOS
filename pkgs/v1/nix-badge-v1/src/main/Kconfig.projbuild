## pkgs/v1/nix-badge-v1/src/main/Kconfig.projbuild
```kconfig
menu "NixBadge Configuration"
  choice BADGE_HW_REV
    prompt "Hardware revision"
    default BADGE_HW_REV_0_5
    help
      Select the hardware revision to target

    config BADGE_HW_REV_0_5
      bool "0_5"
      prompt "Revision 0.5"

    config BADGE_HW_REV_1_0
      bool "1_0"
      prompt "Revision 1.0"
      select BADGE_ENABLE_SDCARD
  endchoice

  config BADGE_ENABLE_SDCARD
    prompt "Enable sdcard"
    bool "ENABLE_SDCARD"
    default n
    depends on !BADGE_HW_REV_0_5
    help
      Enables the sdcard to be available for local cache.
endmenu
```

## pkgs/v1/nix-badge-v1/src/sdkconfig.defaults
```kconfig
CONFIG_LWIP_IP_FORWARD=y
CONFIG_LWIP_IPV4_NAPT=y
CONFIG_PARTITION_TABLE_CUSTOM=y
CONFIG_PARTITION_TABLE_CUSTOM_FILENAME="partitions.csv"
CONFIG_PARTITION_TABLE_FILENAME="partitions.csv"
CONFIG_PARTITION_TABLE_OFFSET=0x8000
CONFIG_PARTITION_TABLE_MD5=y
CONFIG_ESPTOOLPY_FLASHSIZE_4MB=y
CONFIG_MESH_LITE_ENABLE=y
CONFIG_MESH_LITE_VENDOR_ID_0=69
CONFIG_MESH_LITE_VENDOR_ID_1=420
CONFIG_MESH_LITE_ID=69420
CONFIG_MESH_LITE_MAX_ROUTER_NUMBER=3
CONFIG_MESH_LITE_MAXIMUM_LEVEL_ALLOWED=5
CONFIG_JOIN_MESH_WITHOUT_CONFIGURED_WIFI_INFO=y
CONFIG_JOIN_MESH_IGNORE_ROUTER_STATUS=y
CONFIG_DEVICE_CATEGORY="NixBadge"
CONFIG_BRIDGE_SOFTAP_SSID_END_WITH_THE_MAC=y
CONFIG_BRIDGE_SOFTAP_SSID="NixBadge"
CONFIG_FREERTOS_TIMER_TASK_STACK_DEPTH=32768
CONFIG_BADGE_HW_REV_1_0=y
```
